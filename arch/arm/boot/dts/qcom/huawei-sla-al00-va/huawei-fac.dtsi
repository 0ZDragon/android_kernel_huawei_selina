/{
		huawei_fac_info {
		compatible = "huawei,hw_fac_info";
		fac,product_name = "SLA-AL00";
		fac,hardware_ver = "SH1SLA-AL00";
		fac,software_ver = "SLA_AL00_VA";
		fac,simcard_adapt = "support";
		status = "ok";
	};
};
