/*=============================================================================
                           Huawei Base Dtsi File
  GENERAL DESCRIPTION
    This file is for include the Communal node

  Copyright 2010-2014 by HUAWEI Technologies, Inc.  All Rights Reserved.
=============================================================================*/
#include "msm8937.dtsi"
#include "msm8937-pmi8937-qrd-sku2.dtsi"
