/{
		huawei_fac_info {
		compatible = "huawei,hw_fac_info";
		fac,product_name = "SLA-L23";
		fac,hardware_ver = "SH1SLA-L23";
		fac,software_ver = "SLA_L23_VA";
		fac,simcard_adapt = "support";
		status = "ok";
	};
};
